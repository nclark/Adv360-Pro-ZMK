// herdr prefix layer: hold the Ctrl+B thumb key (position 65) and press a key to
// send Ctrl+B followed by that key. Keys sit where they are on the base layer, so
// "prefix, h" is hold-thumb + H. Bindings mirror ~/.config/herdr/config.toml:
//   h j k l   focus pane     -  split top/bottom   v  split side by side
//   x close   z zoom   ; last pane   , rename pane   c new tab   r rename tab
//   p / n prev / next tab   1-9 go to tab   d detach   [ copy mode   ? help   q reload
//   w workspace picker   g goto   e edit scrollback   b toggle sidebar   Tab next pane
//   with Shift held (hd_* mod-morphs in adv360.keymap, physical Shift masked):
//   C new workspace   R rename ws   K close ws   P / N prev / next ws   O annotate
//   G new worktree   Tab previous pane
// J keeps its home-row Shift on hold (hd_hm_j), so thumb + J held + C/R works for the
// left-hand workspace keys; F (hm_l) only holds for right-hand keys like K.
herdr {
  display-name = "herdr";
  bindings = <
    &trans &herdr N1 &herdr N2 &herdr N3 &herdr N4 &herdr N5 &trans                                                     &trans &herdr N6 &herdr N7 &herdr N8 &herdr N9 &trans &trans
    &hd_tab &herdr Q &herdr W  &herdr E  &hd_r     &trans    &trans                                                     &trans &trans    &trans    &trans    &hd_o     &hd_p    &herdr MINUS
    &trans &trans    &trans    &herdr D  &trans    &hd_g     &trans           &trans &trans &trans &trans        &trans &herdr H  &hd_hm_j RSHFT J &hd_k &herdr L  &herdr SEMI &trans
    &trans &herdr Z  &herdr X  &hd_c     &herdr V  &herdr B                           &trans &trans                     &hd_n    &trans    &herdr COMMA &trans &herdr QMARK &trans
    &trans &trans    &trans    &trans    &trans                   &trans &trans &trans &trans &trans &trans              &trans   &trans    &herdr LBKT &trans &trans
  >;
};
