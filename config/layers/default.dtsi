default_layer {
  display-name = "default";
  bindings = <
    &kp EQUAL &kp N1    &kp N2   &kp N3   &kp N4     &kp N5 &tog 2                                                           &mo 4 &kp N6 &kp N7 &kp N8    &kp N9   &kp N0   &kp BSPC
    &kp TAB   &kp Q     &kp W    &kp E    &kp R      &kp T  &kp C_VOL_UP                                                     &kp C_MUTE &kp Y  &kp U  &kp I     &kp O    &kp P    &kp MINUS
    &kp ESC   &hm_l LALT A  &hm_l LCTRL S  &hm_l LGUI D  &hm_l LSHFT F  &kp G  &kp C_VOL_DN        &dictation     &none    &none     &voicectrl             &kp C_PP &kp H  &hm_r RSHFT J  &hm_r RGUI K  &hm_r RCTRL L  &hm_r RALT SEMI &kp SQT
    &shift_const_l LSHFT 5 &kp Z     &kp X    &kp C    &kp V      &kp B                            &kp HOME &kp PG_UP                           &kp N  &kp M  &kp COMMA &kp DOT  &kp FSLH &kp BSLH
    &mo 3     &kp GRAVE &kp PSCRN    &kp LEFT &kp RIGHT                   &kp BSPC &lt 1 ESC &kp END  &kp PG_DN &kp ENTER &kp SPACE              &kp DOWN  &kp UP     &kp LBKT &kp RBKT &mo 3
  >;
};
