navigation {
  display-name = "navigation";
  bindings = <
    &trans &trans &trans &trans &trans &trans &trans                                                           &trans &trans &trans &trans &trans &trans &trans
    &trans &trans &trans &trans &trans &trans &trans                                                           &trans &trans &trans &trans &trans &trans &trans
    &trans &trans &trans &trans &trans &trans &trans           &trans &trans &trans &trans           &trans &kp LEFT &kp DOWN &kp UP &kp RIGHT &trans &trans
    &trans &trans &trans &trans &trans &trans                             &trans &trans                              &trans &trans &trans &trans &trans &trans
    &trans &trans &trans &trans &trans               &trans &trans &trans &trans &trans &trans              &trans &trans &trans &trans &trans
  >;
};
